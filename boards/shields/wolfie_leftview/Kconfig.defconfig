## boards/shields/wolfie_leftview/Kconfig.defconfig
```kconfig
# A dedicated, simple left peripheral status screen.
if SHIELD_WOLFIE_LEFTVIEW

config LV_Z_VDB_SIZE
    default 100

config LV_Z_BITS_PER_PIXEL
    default 1

choice LV_COLOR_DEPTH
    default LV_COLOR_DEPTH_1
endchoice

choice ZMK_DISPLAY_WORK_QUEUE
    default ZMK_DISPLAY_WORK_QUEUE_DEDICATED
endchoice

choice ZMK_DISPLAY_STATUS_SCREEN
    default ZMK_DISPLAY_STATUS_SCREEN_CUSTOM
endchoice

config LV_Z_MEM_POOL_SIZE
    default 8192

config ZMK_DISPLAY_DEDICATED_THREAD_STACK_SIZE
    default 4096

endif
```

## boards/shields/wolfie_leftview/Kconfig.shield
```kconfig
config SHIELD_WOLFIE_LEFTVIEW
    def_bool $(shields_list_contains,wolfie_leftview)
```

## boards/shields/wolfie_niceview/Kconfig.shield
```kconfig
config SHIELD_WOLFIE_NICEVIEW
    def_bool $(shields_list_contains,wolfie_niceview)
```
