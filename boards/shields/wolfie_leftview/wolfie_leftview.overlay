/* The wolfie_display_bus shield provides nice_view_spi on SPI1 (P0.20, P0.17, P0.06). */
&nice_view_spi {
    status = "okay";

    wolfie_left_view: ls0xx@0 {
        compatible = "sharp,ls0xx";
        spi-max-frequency = <1000000>;
        reg = <0>;
        width = <160>;
        height = <68>;
        serial-vcom-inversion;
        serial-vcom-interval = <33>;
    };
};

/ {
    chosen {
        zephyr,display = &wolfie_left_view;
    };
};
